## app/drivers/sensor/cirque_pinnacle/Kconfig
```kconfig
# Copyright (c) 2025 ZMK Contributors
# SPDX-License-Identifier: MIT

config CIRQUE_PINNACLE
    bool "Cirque Pinnacle Touchpad"
    depends on I2C
    help
      Enable driver for Cirque Pinnacle Touchpad over I2C.

if CIRQUE_PINNACLE

config CIRQUE_PINNACLE_INIT_PRIORITY
    int "Cirque Pinnacle initialization priority"
    default 80
    help
      Initialization priority for the Cirque Pinnacle touchpad.

config CIRQUE_PINNACLE_THREAD_PRIORITY
    int "Priority of the Cirque Pinnacle touchpad thread"
    default 10
    help
      Priority of the touchpad thread.

config CIRQUE_PINNACLE_THREAD_STACK_SIZE
    int "Stack size for the Cirque Pinnacle touchpad thread"
    default 1024
    help
      Stack size for the touchpad thread.

config CIRQUE_PINNACLE_POLL_INTERVAL_MS
    int "Polling interval in milliseconds"
    default 10
    help
      Interval between polling the touchpad for new data.

config CIRQUE_PINNACLE_GESTURE_SUPPORT
    bool "Enable gesture support"
    default y
    help
      Enable support for multi-finger gestures.

endif # CIRQUE_PINNACLE
```

## app/dts/bindings/sensor/cirque,pinnacle.yaml
```yaml
# Copyright (c) 2025 ZMK Contributors
# SPDX-License-Identifier: MIT

description: Cirque Pinnacle Touchpad

compatible: "cirque,pinnacle"

include: i2c-device.yaml

properties:
  dr-gpios:
    type: phandle-array
    description: Data ready pin
    required: false
```

## config/boards/shields/kyria_touchpad/Kconfig.defconfig
```kconfig
# Copyright (c) 2025 ZMK Contributors
# SPDX-License-Identifier: MIT

if SHIELD_KYRIA_TOUCHPAD_LEFT

config ZMK_KEYBOARD_NAME
    default "Kyria Touchpad"

config ZMK_SPLIT_ROLE_CENTRAL
    default y

endif

if SHIELD_KYRIA_TOUCHPAD_LEFT || SHIELD_KYRIA_TOUCHPAD_RIGHT

config ZMK_SPLIT
    default y

endif
```

## config/boards/shields/kyria_touchpad/Kconfig.shield
```kconfig
# Copyright (c) 2025 ZMK Contributors
# SPDX-License-Identifier: MIT

config SHIELD_KYRIA_TOUCHPAD_LEFT
    def_bool $(shields_list_contains,kyria_touchpad_left)

config SHIELD_KYRIA_TOUCHPAD_RIGHT
    def_bool $(shields_list_contains,kyria_touchpad_right)
```

## config/west.yml
```yaml
manifest:
  remotes:
    - name: zmkfirmware
      url-base: https://github.com/zmkfirmware
    - name: englmaxi
      url-base: https://github.com/englmaxi
    - name: petejohanson
      url-base: https://github.com/petejohanson
    - name: urob
      url-base: https://github.com/urob
  projects:
    - name: zmk
      remote: zmkfirmware
      revision: main
      import: app/west.yml
    - name: zmk-dongle-display
      remote: englmaxi
      revision: main
    - name: cirque-input-module
      remote: petejohanson
      revision: main
    - name: zmk-helpers
      remote: urob
      revision: main
  self:
    path: config
```
