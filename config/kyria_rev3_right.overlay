#include "./shared.dtsi"

&pro_micro_i2c {
    status = "okay";

    glidepoint: glidepoint@2a {
        status = "okay";
    };
};

// Overrides for the input listener node
&glidepoint_listener {
    status = "okay";
    device = <&glidepoint>;
};


&glidepoint_split {
    device = <&glidepoint0>;
};
