#include "./shared.dtsi"

&pro_micro_i2c {
    status = "okay";

    kyria_oled: ssd1306@0 {
        compatible = "solomon,ssd1306fb";
        reg = <0>;
        width = <128>;
        height = <64>;
        segment-offset = <0>;
        page-offset = <0>;
        display-offset = <0>;
        multiplex-ratio = <63>;
        prechargep = <0x22>;
        inversion-on;
    };
};

&glidepoint_listener {
    status = "okay";
};
