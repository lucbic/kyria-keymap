## zmk-caps-clear/dts/bindings/behaviors/zmk,behavior-caps-clear.yaml
```yaml
# Copyright (c) 2026 The ZMK Contributors
# SPDX-License-Identifier: MIT

description: |
  Caps state behavior, invoked with one parameter.

  Parameter 0 — clear whichever caps state is active:
    caps lock on  -> tap the caps binding to turn it off
    caps word on  -> tap the caps word binding to turn it off
    nothing on    -> tap the sticky shift binding

  Parameter 1 — toggle caps word, tracking the state so parameter 0 can see it.

  Caps lock state is read from the host LED indicator. Caps word state is not
  exported by ZMK, so it is shadowed here and cancelled by the same rule
  behavior_caps_word.c applies.

compatible: "zmk,behavior-caps-clear"

include: one_param.yaml

properties:
  bindings:
    type: phandle-array
    required: true
    description: |
      Exactly three, in order: the caps lock key press, the sticky shift, and
      caps word. Passed as phandles so the referenced behaviors are guaranteed
      to exist rather than being looked up by name.
  tap-ms:
    type: int
    default: 100
    description: Milliseconds each synthesized tap is held.
  wait-ms:
    type: int
    default: 30
    description: Milliseconds after each synthesized tap before the next.
```

## zmk-caps-clear/src/Kconfig
```kconfig
# Copyright (c) 2026 The ZMK Contributors
# SPDX-License-Identifier: MIT

config ZMK_BEHAVIOR_CAPS_CLEAR
    bool
    default y
    depends on DT_HAS_ZMK_BEHAVIOR_CAPS_CLEAR_ENABLED
```
